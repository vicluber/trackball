## Kconfig
```kconfig
config BB_TRACKBALL
	bool "Blackberry Trackball Driver"
	default y
	depends on DT_HAS_ZMK_BB_TRACKBALL_ENABLED
	select INPUT
```

## config/dts/bindings/input/zmk,bb-trackball.yaml
```yaml
description: Blackberry optical trackball (GPIO edge-triggered)

compatible: "zmk,bb-trackball"

include: base.yaml

properties:
  up-gpios:
    type: phandle-array
    required: true
  down-gpios:
    type: phandle-array
    required: true
  left-gpios:
    type: phandle-array
    required: true
  right-gpios:
    type: phandle-array
    required: true
```
